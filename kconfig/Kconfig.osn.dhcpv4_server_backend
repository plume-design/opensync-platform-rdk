## kconfig/Kconfig.osn.dhcpv4_server_backend
```kconfig
if PLATFORM_IS_RDK

config OSN_BACKEND_DHCPV4_SERVER_RDK
    bool "RDK DHCP v4 server"
    help
        Use RDK specific implementation of OSN DHCP v4 API

endif
```

## kconfig/Kconfig.osp_unit.backend
```kconfig
if PLATFORM_IS_RDK

config OSP_UNIT_RDK
    bool "RDK unit"
    help
        Use RDK specific implementation of OSP Unit API

endif
```

## kconfig/Kconfig.platform
```kconfig
menuconfig PLATFORM_IS_RDK
    bool "RDK"
    help
        Support for RDK-based platforms

if PLATFORM_IS_RDK

config RDK_LAN_BRIDGE_NAME
    string "LAN bridge name"
    default "br-home"
    help
        LAN bridge name that will be used

config RDK_HOME_AP_24_IFNAME
    string "Home AP 2.4 GHz interface name"
    default "home-ap-24"
    help
        Home AP 2.4 GHz name that will be used

config RDK_HOME_AP_50_IFNAME
    string "Home AP 5 GHz interface name"
    default "home-ap-50"
    help
        Backhaul AP 5 GHz name that will be used

config RDK_HOME_AP_60_IFNAME
    string "Home AP 6 GHz interface name"
    default "home-ap-60"
    depends on RDK_6G_RADIO_SUPPORT
    help
        Backhaul AP 6 GHz name that will be used

config RDK_BHAUL_AP_24_IFNAME
    string "Backhaul AP 2.4 GHz interface name"
    default "bhaul-ap-24"
    help
        Backhaul AP 2.4 GHz name that will be used

config RDK_BHAUL_AP_50_IFNAME
    string "Backhaul AP 5 GHz interface name"
    default "bhaul-ap-50"
    help
        Backhaul AP 5 GHz name that will be used

config RDK_BHAUL_AP_60_IFNAME
    string "Backhaul AP 6 GHz interface name"
    default "bhaul-ap-60"
    depends on RDK_6G_RADIO_SUPPORT
    help
        Backhaul AP 6 GHz name that will be used

config RDK_ONBOARD_AP_24_IFNAME
    string "Onboard AP 2.4 GHz interface name"
    default "onboard-ap-24"
    help
        Onboard AP 2.4 GHz name that will be used

config RDK_ONBOARD_AP_50_IFNAME
    string "Onboard AP 5 GHz interface name"
    default "onboard-ap-50"
    help
        Onboard AP 5 GHz name that will be used

config RDK_ONBOARD_AP_60_IFNAME
    string "Onboard AP 6 GHz interface name"
    default "onboard-ap-60"
    depends on RDK_6G_RADIO_SUPPORT
    help
        Onboard AP 6 GHz name that will be used

config RDK_C_PORTAL_AP_24_IFNAME
    string "Captive portal AP 2.4 GHz interface name"
    default "cp-24"
    help
        Captive portal AP 2.4 GHz name that will be used. Required for
        WorkPass

config RDK_C_PORTAL_AP_50_IFNAME
    string "Captive portal AP 5 GHz interface name"
    default "cp-50"
    help
        Captive portal AP 5 GHz name that will be used. Required for WorkPass

config RDK_C_PORTAL_AP_60_IFNAME
    string "Captive AP 6 GHz interface name"
    default "cp-60"
    depends on RDK_6G_RADIO_SUPPORT
    help
        Captive portal AP 6 GHz name that will be used. Required for WorkPass

config RDK_FRONTHAUL_AP_24_IFNAME
    string "Fronthaul AP 2.4 GHz interface name"
    default "fhaul-ap-24"
    help
        Fronthaul AP 2.4 GHz name that will be used. Required for WorkPass

config RDK_FRONTHAUL_AP_50_IFNAME
    string "Fronthaul AP 5 GHz interface name"
    default "fhaul-ap-50"
    help
        Fronthaul AP 5 GHz name that will be used. Required for WorkPass

config RDK_FRONTHAUL_AP_60_IFNAME
    string "Fronthaul AP 6 GHz interface name"
    default "fhaul-ap-60"
    depends on RDK_6G_RADIO_SUPPORT
    help
        Fronthaul AP 6 GHz name that will be used. Required for WorkPass

config RDK_6G_RADIO_SUPPORT
    bool "6G radio support"
    default n
    help
        Support for 6G radio

config RDK_BHAUL_USE_BRIDGE
    bool "Use bridge for Backhaul and onbard AP"
    default n
    help
        Backhaul and onbard AP interfaces are configured under bridge interfaces
        This option will configure IP addresses on bridge interfaces instead of VAP interface

config RDK_BHAUL_AP_24_BRIDGE_IFNAME
    string "Bridge Backhaul AP 2.4 GHz interface name"
    default "brbhap24"
    depends on RDK_BHAUL_USE_BRIDGE
    help
        Bridge interface name used for Backhaul AP 2.4 GHz

config RDK_BHAUL_AP_50_BRIDGE_IFNAME
    string "Bridge Backhaul AP 5 GHz interface name"
    default "brbhap50"
    depends on RDK_BHAUL_USE_BRIDGE
    help
        Bridge interface name used for Backhaul AP 5 GHz

config RDK_BHAUL_AP_60_BRIDGE_IFNAME
    string "Bridge Backhaul AP 6 GHz interface name"
    default "brbhap60"
    depends on RDK_6G_RADIO_SUPPORT && RDK_BHAUL_USE_BRIDGE
    help
        Bridge interface name used for Backhaul AP 6 GHz

config RDK_ONBOARD_AP_24_BRIDGE_IFNAME
    string "Bridge Onboard AP 2.4 GHz interface name"
    default "bronap24"
    depends on RDK_BHAUL_USE_BRIDGE
    help
        Bridge interface name used for Onboard AP 2.4 GHz

config RDK_ONBOARD_AP_50_BRIDGE_IFNAME
    string "Bridge Onboard AP 5 GHz interface name"
    default "bronap50"
    depends on RDK_BHAUL_USE_BRIDGE
    help
        Bridge interface name used for Onboard AP 5 GHz

config RDK_ONBOARD_AP_60_BRIDGE_IFNAME
    string "Bridge Onboard AP 6 GHz interface name"
    default "bronap60"
    depends on RDK_6G_RADIO_SUPPORT && RDK_BHAUL_USE_BRIDGE
    help
        Bridge interface name used for Onboard AP 6 GHz

config RDK_CHIPSET_NAME_2G
    string "2.4 GHz radio wifi chipset name"
    default "Chipset2G"
    help
        Human-readable Wifi chipset name of 2.4GHz radio

config RDK_CHIPSET_NAME_5G
    string "5 GHz radio wifi chipset name"
    default "Chipset5G"
    help
        Human-readable Wifi chipset name of 5GHz radio

config RDK_CHIPSET_NAME_6G
    string "6 GHz radio wifi chipset name"
    default "Chipset6G"
    depends on RDK_6G_RADIO_SUPPORT
    help
        Human-readable Wifi chipset name of 6GHz radio

config RDK_CONTROL_ALL_VAPS
    bool "Allow OpenSync to control all VAP interfaces"
    help
        Select this option if you want to see all the Wifi interfaces
        in the Wifi_VIF_Config and Wifi_VIF_State tables.
        Do not use this option if there are some interfaces that are
        controlled only outside of OpenSync framework.

config RDK_LAN_ETH_IFNAME
    string "LAN ethernet interface name"
    default "eth0"
    help
        Interface name on which ethernet clients
        are connected

config RDK_MOCA_IFNAME
    string "MOCA interface name"
    default "moca0"
    help
        MOCA interface name

config RDK_HEALTHCHECK_INTERVAL
    int "Radio and VIF states healthcheck interval in seconds"
    default "120"
    help
        The interval at which OpenSync will read Radio and VIF
        information to keep OVSDB state tables up-to-date.

config RDK_VIF_STATE_UPDATE_DELAY
    int "VIF state update delay in seconds"
    default "3"
    help
        The delay from applying Wifi_VIF_Config changes until
        Wifi_VIF_State resynchronization. This is addressing
        asynchronous changes in wifi setup.

config RDK_HAS_ASSOC_REQ_IES
    bool "The wifi_getAssociationReqIEs is implemented"
    help
        The wifi_getAssociationReqIEs() is a pending Wi-Fi HAL API.
        If implemented, then Band Steering Manager can request
        connected client's capabilities on demand.
        Otherwise it will depend only on capabilities delivered with
        a BS CONNECT event. If the event is missed for some reason,
        the band steering manager will not have all the information
        until the next CONNECT event.

config RDK_MULTI_PSK_SUPPORT
    bool "Multi-PSK support"
    default n
    help
        This enables Multi-PSK support.
        This feature depends on a set of new wifihal API functions:
        wifi_newApAssociatedDevice_callback2(),
        wifi_getApAssociatedDeviceDiagnosticResult4(),
        wifi_pushMultiPskKeys(),
        wifi_getMultiPskKeys()

config RDK_DISABLE_SYNC
    bool "RDK disable sync with MeshAgent"
    default n

config RDK_EXTENDER
    bool "RDK Extender device"
    default n

config RDK_WPS_SUPPORT
    bool "WPS support"
    default n
    help
        This feature enables WPS support.

config RDK_MULTI_AP_SUPPORT
    bool "Multi AP support"
    default n
    help
        This feature enables Multi AP support.

config RDK_MGMT_FRAME_CB_SUPPORT
    bool "Management frames callback support"
    default n
    help
        This feature uses RDK HAL API to provide to
        OpenSync received raw management frames. OpenSync
        parses those frames for Band Steering purpose.

config RDK_DHCP_LEASES_PATH
    string "DHCP leases path"
    default "/nvram/dnsmasq.leases"
    help
        DHCP leases path

config RDK_SYNC_EXT_HOME_ACLS
    bool "Sync externally configured ACLs on home APs to VIF config"
    default n
    help
        This enables synchronization of externally configured ACLs on
        home APs to VIF Config and State tables to prevent their removal
        upon next event of applying configuration.

config RDK_WIFI_HAL_VERSION_3_PHASE2
    bool "Enable WIFI_HAL_VERSION_3_PHASE2"
    default n
    help
        Enable wifi_hal 3.0 phase 2

config RDK_CUMULATIVE_SURVEY_ONCHAN
    int "Cumulative ONCHAN survey reporting"
    default 1
    help
        Select 1 if counters returned by wifi_getRadioChannelStats()
        HAL for on-channel (current operating channel) are
        cumulative (monotonic). Select 0 if those counters represent
        a one-shot measurement and subsequent calls should not assume
        previous data to be relevant for delta calculation.

config RDK_CUMULATIVE_SURVEY_OFFCHAN
    int "Cumulative OFFCHAN survey reporting"
    default 1
    help
        Select 1 if counters returned by wifi_getRadioChannelStats()
        HAL for off-channel (current non-operating channel) are
        cumulative (monotonic). Select - if those counters represent
        a one-shot measurement and subsequent calls should not assume
        previous data to be relevant for delta calculation.

if MANAGER_XM

config RDK_CONNECTOR_DHCP_SYNC_LAN_MANAGEMENT
    bool "Connector sync LAN IP during DHCP setup"
    default n
    help
        Before setting DHCP config sync LAN IP and network subnet in TR-181 DM.
        Sync Device.X_CISCO_COM_DeviceControl.LanManagementEntry.1.LanIPAddress
        and Device.X_CISCO_COM_DeviceControl.LanManagementEntry.1.LanSubnetMask


endif

config RDK_DM_MODEL_NUM
    string "Access key: Device model name"
    default "Device.DeviceInfo.ModelName"
    help
        TR-181 DM parameter name providing device friendly
        name used in the network

config RDK_DM_SERIAL_NUM
    string "Access key: Device serial number"
    default "Device.DeviceInfo.SerialNumber"
    help
        TR-181 DM parameter name providing device serial
        number as seen on the BAR code

config RDK_DM_SOFTWARE_VER
    string "Access key: Device software version"
    default "Device.DeviceInfo.SoftwareVersion"
    help
        TR-181 DM parameter name providing joined platform
        firmware version containing OpenSync

config RDK_DM_CM_MAC
    string "Access key: CM MAC address"
    default "Device.DeviceInfo.X_RDKCENTRAL-COM_CMTS_MAC"
    help
        TR-181 DM parameter name providing MAC address of the base
        network interface, also used as part of node identification

config RDK_DM_MESH_STATE
    string "Access key: Mesh state"
    default "Device.DeviceInfo.X_RDKCENTRAL-COM_xOpsDeviceMgmt.Mesh.State"
    help
        TR-181 DM parameter name providing actual device
        mode as cloud or monitor

config RDK_DM_MESH_URL
    string "Access key: Mesh URL"
    default "Device.DeviceInfo.X_RDKCENTRAL-COM_xOpsDeviceMgmt.Mesh.URL"
    help
        TR-181 DM parameter name providing cloud redirector address
        specific for different deployments (production or development)

endif
```
